## kernel_src/drivers/kdriver/nand/Kconfig
```kconfig
config MSTAR_NAND
	tristate "NAND"
	# dhjung LGE
	depends on MSTAR_DRIVER
	# dhjung LGE
	default n
	help
		Support Mstar Nand Flash Driver
```

## kernel_src/drivers/kdriver/probe/Kconfig
```kconfig
config MSTAR_PROBE

tristate "PROBE"
	# dhjung LGE
	depends on MSTAR_DRIVER
#    depends on
	# dhjung LGE
	default y
	help
    	enable MStar PROBE feature
```

## kernel_src/drivers/kdriver/pwm/Kconfig
```kconfig
config MSTAR_PWM

tristate "PWM"
	# dhjung LGE
	depends on MSTAR_DRIVER
	# dhjung LGE
	default n
	help
    	MStar PWM driver function
```

## kernel_src/drivers/kdriver/pws/Kconfig
```kconfig
config MSTAR_PWS
tristate "PWS"
	default n
	help
		Enable compilation option for driver PWS
```

## kernel_src/drivers/kdriver/rld/Kconfig
```kconfig
config MSTAR_RLD

tristate "MStar DTV RLD Support"
	# dhjung LGE
	depends on MSTAR_DRIVER
	# dhjung LGE
	default n
	help
    	Titania RLD driver function
    
```

## kernel_src/drivers/kdriver/scaler/Kconfig
```kconfig
config MSTAR_SCALER

tristate "Scaler"
	# dhjung LGE
	depends on MSTAR_DRIVER
	# dhjung LGE
	default n
	help
    	MStar Scaler driver function
    
```

## kernel_src/drivers/kdriver/spi/Kconfig
```kconfig
config MSTAR_SPI

tristate "SPI"
default y

---help---
Enable compilation option for driver SPI
```

## kernel_src/drivers/kdriver/str/Kconfig
```kconfig
config MSTAR_STR

tristate "STR"
	# dhjung LGE
	depends on MSTAR_DRIVER
	# dhjung LGE
	default n
	help
    	enable MStar suspend to RAM feature
    
```

## kernel_src/drivers/kdriver/system/Kconfig
```kconfig
config MSTAR_SYSTEM

tristate "System"
	# dhjung LGE
	depends on MSTAR_DRIVER
	select CRC32
	# dhjung LGE
	default n
```

## kernel_src/drivers/kdriver/tsp/Kconfig
```kconfig
config MSTAR_TSP

tristate "TSP"
	# dhjung LGE
	depends on MSTAR_DRIVER
	select CRC32
	# dhjung LGE
	default n
	help
```

## kernel_src/drivers/kdriver/ttx/Kconfig
```kconfig
config MSTAR_TTX
	tristate "TTX"
	# dhjung LGE
	depends on MSTAR_DRIVER
	# dhjung LGE
	default n
	help
    	enable MStar TTX driver.
    
```

## kernel_src/drivers/kdriver/vd/Kconfig
```kconfig
config MSTAR_VD

tristate "VD"
	# dhjung LGE
	depends on MSTAR_DRIVER
	# dhjung LGE
	default n
	help
    	enable MStar Video decoder driver function
    
```

## kernel_src/drivers/kdriver/ve/Kconfig
```kconfig
config MSTAR_VE

tristate TVEncoder
	# dhjung LGE
	depends on MSTAR_DRIVER
	# dhjung LGE
	default n
	help
		Enable compilation option for driver TVEncoder
```

## kernel_src/kernel/linux-2.6.26-saturn7/arch/mips/Kconfig.version
```kconfig
config VALID_KERNEL
	string "Default Valid kernel Version"
	default "1.00.00"
	help
		Determine valid kernel version. If this kernel version is not matched with
		version which application have, application will not be run.
```

## kernel_src/kernel/linux-2.6.26-saturn7/drivers/bluetooth_lge/Kconfig
```kconfig
menu "Bluetooth Support by LGE"

source "drivers/bluetooth_lge/csr/Kconfig"

endmenu
```

## kernel_src/kernel/linux-2.6.26-saturn7/drivers/bluetooth_lge/csr/Kconfig
```kconfig
config BT_CSR

tristate "Support CSR Bluetooth Module"
	default n
	help
    	CSR Bluetooth Driver
```
