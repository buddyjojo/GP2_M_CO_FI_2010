## kernel_src/drivers/kdriver/Kconfig
```kconfig
# drivers/MStar/Kconfig

menu "MStar Platform Configuration"

# dhjung LGE
config MSTAR_DRIVER
	tristate "MStar Driver Support"

#===================================================
# MStar Chip Selection
#===================================================
choice
	prompt "MStar Chip Selection"
	default None

config MSTAR_NONE
	bool "None"

config MSTAR_TITANIA
	bool "Titania"
	select BOOT_ELF32
	select DMA_NONCOHERENT
	select MIPS_BOARDS_GEN
	select CEVT_R4K
	select CSRC_R4K
	select IRQ_CPU
	select SYS_HAS_CPU_MIPS32_R1
	select SYS_HAS_CPU_MIPS32_R2
	select SYS_HAS_EARLY_PRINTK
	select SYS_SUPPORTS_32BIT_KERNEL
	select SYS_SUPPORTS_BIG_ENDIAN
	select SYS_SUPPORTS_LITTLE_ENDIAN
	select SYS_SUPPORTS_MULTITHREADING

config MSTAR_TRITON
	bool "Triton"
	select BOOT_ELF32
	select DMA_NONCOHERENT
	select MIPS_BOARDS_GEN
	select CEVT_R4K
	select CSRC_R4K
	select IRQ_CPU
	select SYS_HAS_CPU_MIPS32_R1
	select SYS_HAS_CPU_MIPS32_R2
	select SYS_HAS_EARLY_PRINTK
	select SYS_SUPPORTS_32BIT_KERNEL
	select SYS_SUPPORTS_BIG_ENDIAN
	select SYS_SUPPORTS_LITTLE_ENDIAN
	select SYS_SUPPORTS_MULTITHREADING

config MSTAR_TITANIA2
	bool "Titania2"
	select BOOT_ELF32
	select DMA_NONCOHERENT
	select MIPS_BOARDS_GEN
	select CEVT_R4K
	select CSRC_R4K
	select IRQ_CPU
	select SYS_HAS_CPU_MIPS32_R1
	select SYS_HAS_CPU_MIPS32_R2
	select SYS_HAS_EARLY_PRINTK
	select SYS_SUPPORTS_32BIT_KERNEL
	select SYS_SUPPORTS_BIG_ENDIAN
	select SYS_SUPPORTS_LITTLE_ENDIAN
	select SYS_SUPPORTS_MULTITHREADING

config MSTAR_TITANIA3
	bool "Titania3"
	select BOOT_ELF32
	select DMA_NONCOHERENT
	select MIPS_BOARDS_GEN
	select CEVT_R4K
	select CSRC_R4K
	select IRQ_CPU
	select SYS_HAS_CPU_MIPS32_R1
	select SYS_HAS_CPU_MIPS32_R2
	select SYS_HAS_EARLY_PRINTK
	select SYS_SUPPORTS_32BIT_KERNEL
	select SYS_SUPPORTS_BIG_ENDIAN
	select SYS_SUPPORTS_LITTLE_ENDIAN
	select SYS_SUPPORTS_MULTITHREADING
	select HIGHMEM
	select SYS_SUPPORTS_HIGHMEM
	select CPU_HAS_SYNC

endchoice

#===================================================
# MStar Chip (auto-select)
# 0: None
# 1: Titania
# 2: Triton
# 3: Titania2
# 4: Titania3
#===================================================
config MSTAR_CHIP_TYPE
	int
	default 1 if MSTAR_TITANIA
	default 2 if MSTAR_TRITON
	default 3 if MSTAR_TITANIA2
    default 4 if MSTAR_TITANIA3
	default 0

#===================================================
# MStar Chip Name (auto-select)
#===================================================
config MSTAR_CHIP_NAME
	string
	default "titania" if MSTAR_TITANIA
	default "triton" if MSTAR_TRITON
	default "titania2" if MSTAR_TITANIA2
    default "titania3" if MSTAR_TITANIA3
	default "error"

#===================================================
# FIXME: remove this later - cc.chen
#===================================================
config Titania
	bool
	default y if MSTAR_TITANIA

config Triton
	bool
	default y if MSTAR_TRITON

config Titania2
	bool
	default y if MSTAR_TITANIA2

config Titania3
	bool
	default y if MSTAR_TITANIA3

#===================================================
# MStar Device Drivers
#===================================================
comment "MStar Device Drivers"

if !MSTAR_NONE
#==========================================
# Remove this latter - cc.chen
#==========================================
source "drivers/mstar/Kconfig-Board"
source "drivers/mstar/Kconfig-MMap"

config MSTAR_TITANIA_BD_T2_LG_256MDDR_BOARD
	bool "Select 256M DDR"
	default n

#===================================================
# MStar DTV Device Driver
#===================================================
source "drivers/mstar/nand/Kconfig"
source "drivers/mstar/tsp/Kconfig"
source "drivers/mstar/ge/Kconfig"
source "drivers/mstar/gop/Kconfig"
source "drivers/mstar/mpool/Kconfig"
source "drivers/mstar/iic/Kconfig"
source "drivers/mstar/gpio/Kconfig"
source "drivers/mstar/pwm/Kconfig"
source "drivers/mstar/emac/Kconfig"
source "drivers/mstar/system/Kconfig"
source "drivers/mstar/scaler/Kconfig"
#source "drivers/mstar/miu/Kconfig"
source "drivers/mstar/mad/Kconfig"
source "drivers/mstar/vd/Kconfig"
source "drivers/mstar/mvop/Kconfig"
source "drivers/mstar/mvd/Kconfig"
source "drivers/mstar/h264/Kconfig"
source "drivers/mstar/ir/Kconfig"
#source "drivers/mstar/8051/Kconfig"
source "drivers/mstar/micom/Kconfig"
source "drivers/mstar/ci/Kconfig"
#source "drivers/mstar/aeon/Kconfig"
#source "drivers/mstar/rld/Kconfig"
source "drivers/mstar/ttx/Kconfig"
#source "drivers/mstar/mlink/Kconfig"
source "drivers/mstar/ve/Kconfig"
source "drivers/mstar/cc/Kconfig"
source "drivers/mstar/jpeg/Kconfig"
#source "drivers/mstar/fbdev/Kconfig"
source "drivers/mstar/msmailbox/Kconfig"
#source "drivers/mstar/avs/Kconfig"
source "drivers/mstar/spi/Kconfig"
source "drivers/mstar/str/Kconfig"
source "drivers/mstar/m4ve/Kconfig"
source "drivers/mstar/dip/Kconfig"
#source "drivers/mstar/rtc/Kconfig"
#source "drivers/mstar/sar/Kconfig"
source "drivers/mstar/cec/Kconfig"
source "drivers/mstar/demod/Kconfig"
#source "drivers/mstar/mfc/Kconfig"
source "drivers/mstar/mpif/Kconfig"
source "drivers/mstar/aesdma/Kconfig"
source "drivers/mstar/bdma/Kconfig"
source "drivers/mstar/pws/Kconfig"
#source "drivers/mstar/logo/Kconfig"
source "drivers/mstar/probe/Kconfig"

endif

endmenu
```

## kernel_src/drivers/kdriver/aesdma/Kconfig
```kconfig
config MSTAR_AESDMA
tristate "AESDMA"
	default n
	help
		Enable compilation option for driver AESDMA
```

## kernel_src/drivers/kdriver/bdma/Kconfig
```kconfig
config MSTAR_BDMA

tristate "BDMA"
	depends on MSTAR_DRIVER
	default n
	help
        MStar Byte DMA driver function
```

## kernel_src/drivers/kdriver/cc/Kconfig
```kconfig
config MSTAR_CC
tristate "CC"
	# dhjung LGE
	depends on MSTAR_DRIVER
	# dhjung LGE
	default n
	help
    	enable MStar CC driver.
```

## kernel_src/drivers/kdriver/ci/Kconfig
```kconfig
config MSTAR_CI
	tristate "CI"
	# dhjung LGE
	depends on MSTAR_DRIVER
	# dhjung LGE
	default n
	help
		Enable compilation option for driver CI 
```

## kernel_src/drivers/kdriver/demod/Kconfig
```kconfig
config MSTAR_DEMOD

tristate "Demod"
	# dhjung LGE
	depends on MSTAR_DRIVER
	# dhjung LGE
	default n
	help
        MStar Demodulator driver function
```

## kernel_src/drivers/kdriver/dip/Kconfig
```kconfig
config MSTAR_DIP

tristate "DIP"
	# dhjung LGE
	depends on MSTAR_DRIVER
	# dhjung LGE
	default n
	help
    	enable MStar DIP
    
```

## kernel_src/drivers/kdriver/emac/Kconfig
```kconfig
config MSTAR_EMAC
select NET
select NET_ETHERNET
select MII
select PACKET
select USE_POLICY_FWD
select INET
select NETDEVICES
select IP_PNP

tristate "EMAC"
	# dhjung LGE
	depends on MSTAR_DRIVER
	# dhjung LGE
	default n
	help
		Enable compilation option for driver EMAC
```

## kernel_src/drivers/kdriver/ge/Kconfig
```kconfig
config MSTAR_GE

tristate "GE"
	# dhjung LGE
	depends on MSTAR_DRIVER
	# dhjung LGE
	default n
	help
		Enable compilation option for driver GE 
```

## kernel_src/drivers/kdriver/gop/Kconfig
```kconfig
config MSTAR_GOP

tristate "GOP"
	# dhjung LGE
	depends on MSTAR_DRIVER
	# dhjung LGE
	default n
	help
		Enable compilation option for driver GOP
```

## kernel_src/drivers/kdriver/gpio/Kconfig
```kconfig
config MSTAR_GPIO

tristate "GPIO"
	# dhjung LGE
	depends on MSTAR_DRIVER
	# dhjung LGE
	default y
	help
    	MStar GPIO driver function
```

## kernel_src/drivers/kdriver/h264/Kconfig
```kconfig
config MSTAR_H264

tristate "H264"
	# dhjung LGe
	depends on MSTAR_DRIVER
	select CRC32
	# dhjung LGe
	default n
	help
```

## kernel_src/drivers/kdriver/iic/Kconfig
```kconfig
config MSTAR_IIC

tristate "IIC"
	# dhjung LGE
	depends on MSTAR_DRIVER
	# dhjung LGE
	default n
	help
   		MStar IIC driver function
    
```

## kernel_src/drivers/kdriver/ir/Kconfig
```kconfig
config MSTAR_IR

tristate "IrDA"
	# dhjung LGE
	depends on MSTAR_DRIVER
	# dhjung LGE
	default n
	help
    	Titania IrDA driver function
    
```

## kernel_src/drivers/kdriver/jpeg/Kconfig
```kconfig
config MSTAR_JPEG

tristate "JPEG"
	# dhjung LGE
	depends on MSTAR_DRIVER
	# dhjung LGE
	default n
        help
    	enable MStar MLINK driver.
    
```

## kernel_src/drivers/kdriver/logo/Kconfig
```kconfig
config MSTAR_LOGO

tristate "Logo"
	# dhjung LGE
	depends on MSTAR_DRIVER
	# dhjung LGE
	default y
```

## kernel_src/drivers/kdriver/m4ve/Kconfig
```kconfig
config MSTAR_M4VE

tristate "M4VE"
	# dhjung LGE
	depends on MSTAR_DRIVER
	select CRC32
	# dhjung LGE
	default n
	help
```

## kernel_src/drivers/kdriver/mad/Kconfig
```kconfig
config MSTAR_MAD

tristate "MAD"
	# dhjung LGE
	depends on MSTAR_DRIVER
	# dhjung LGE
	default n
	help
		Enable compilation option for driver MAD
```

## kernel_src/drivers/kdriver/micom/Kconfig
```kconfig
config MSTAR_MICOM

tristate "MICOM"
	# dhjung LGE
	depends on MSTAR_DRIVER
	# dhjung LGE
	default y
	help
    	Titania MICOM driver function
    
```

## kernel_src/drivers/kdriver/mpif/Kconfig
```kconfig
config MSTAR_MPIF

tristate "MPIF"
	# dhjung LGe
	depends on MSTAR_DRIVER
	select CRC32
	# dhjung LGe
	default n
	help
```

## kernel_src/drivers/kdriver/mpool/Kconfig
```kconfig
config MSTAR_MPOOL

tristate "MPOOL"
	# dhjung LGE
	depends on MSTAR_DRIVER
	# dhjung LGE
	default n
	help
    	MStar MPOOL driver function
    
```

## kernel_src/drivers/kdriver/msmailbox/Kconfig
```kconfig
config MSTAR_MSMAILBOX

tristate "MSMAILBOX"
	# dhjung LGE
	depends on MSTAR_DRIVER
	# dhjung LGE
	default n
	help
    	enable MStar MAILBOX driver.
```

## kernel_src/drivers/kdriver/mvd/Kconfig
```kconfig
config MSTAR_MVD

tristate "MVD"
	# dhjung LGe
	depends on MSTAR_DRIVER
	select CRC32
	# dhjung LGe
	default n
	help
```

## kernel_src/drivers/kdriver/mvop/Kconfig
```kconfig
config MSTAR_MVOP

tristate "MVOP"
	# dhjung LGE
	depends on MSTAR_DRIVER
	select CRC32
	# dhjung LGE
	default n
	help
```
